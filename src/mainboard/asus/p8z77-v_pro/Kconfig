## src/mainboard/asus/p8z77-v_pro/Kconfig
```kconfig
##
## This file is part of the coreboot project.
##
## Copyright (C) 2018 Dan Elkouby <streetwalkermc@gmail.com>
##
## This program is free software: you can redistribute it and/or modify
## it under the terms of the GNU General Public License as published by
## the Free Software Foundation, either version 2 of the License, or
## (at your option) any later version.
##
## This program is distributed in the hope that it will be useful,
## but WITHOUT ANY WARRANTY; without even the implied warranty of
## MERCHANTABILITY or FITNESS FOR A PARTICULAR PURPOSE.  See the
## GNU General Public License for more details.
##

if BOARD_ASUS_P8Z77_V_PRO

config BOARD_SPECIFIC_OPTIONS
	def_bool y
	select BOARD_ROMSIZE_KB_8192
	select CPU_INTEL_SOCKET_LGA1155
	select HAVE_ACPI_RESUME
	select HAVE_ACPI_TABLES
	select INTEL_INT15
	select NORTHBRIDGE_INTEL_IVYBRIDGE
	select SANDYBRIDGE_IVYBRIDGE_LVDS
	select SERIRQ_CONTINUOUS_MODE
	select SOUTHBRIDGE_INTEL_C216
	select USE_NATIVE_RAMINIT
	select SUPERIO_NUVOTON_NCT6779D
	select DRIVERS_ASMEDIA_ASPM_BLACKLIST

config HAVE_IFD_BIN
	bool
	default n

config HAVE_ME_BIN
	bool
	default n

config MAINBOARD_DIR
	string
	default asus/p8z77-v_pro

config MAINBOARD_PART_NUMBER
	string
	default "P8Z77-V Pro"

config VGA_BIOS_FILE
	string
	default "pci8086,0162.rom"

config VGA_BIOS_ID
	string
	default "8086,0162"

config MAINBOARD_PCI_SUBSYSTEM_DEVICE_ID
	hex
	default 0x84ca

config MAINBOARD_PCI_SUBSYSTEM_VENDOR_ID
	hex
	default 0x1043

config MAX_CPUS
	int
	default 8

config USBDEBUG_HCD_INDEX # FIXME: EHCI debug untested
	int
	default 2
endif
```
